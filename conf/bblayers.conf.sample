## conf/bblayers.conf.sample
```bitbake
# StarryOS Yocto 层配置模板
#
# POKY_BBLAYERS_CONF_VERSION is increased each time build/conf/bblayers.conf
# changes incompatibly
POKY_BBLAYERS_CONF_VERSION = "2"

BBPATH = "${TOPDIR}"
BBFILES ?= ""

# 注意: ##OEROOT## 会被 oe-init-build-env 替换为实际路径
BBLAYERS ?= " \
  ##OEROOT##/meta \
  ##OEROOT##/meta-poky \
  ##OEROOT##/meta-yocto-bsp \
  ##OEROOT##/../meta-starry \
"
```

## conf/machine/aarch64-qemu-virt.conf
```bitbake
#@TYPE: Machine
#@NAME: aarch64-qemu-virt
#@DESCRIPTION: ARMv8 QEMU virt machine for StarryOS/ArceOS

# 基础架构配置
require conf/machine/include/arm/armv8a/tune-cortexa57.inc
require conf/machine/include/qemu.inc

# ArceOS 通用配置
require conf/machine/include/arceos-machine-common.inc

# ==================== ArceOS/StarryOS 必须变量 ====================
# 对应 Makefile: ARCH, PLAT_NAME, MYPLAT, TARGET
# 注意: 即使使用 defplat feature，也需要设置 PLAT_PACKAGE 用于配置文件解析
ARCEOS_ARCH = "aarch64"
ARCEOS_PLATFORM = "aarch64-qemu-virt"
ARCEOS_PLAT_PACKAGE = "axplat-aarch64-qemu-virt"
RUST_TARGET = "aarch64-unknown-none-softfloat"

# ==================== 平台策略 ====================
# ARCEOS_USE_MYPLAT: 控制使用 defplat 还是 myplat feature
#   "0" (默认) - 使用 defplat (包含所有平台，体积大但灵活)
#   "1"         - 使用 myplat (仅当前平台，体积小)
ARCEOS_USE_MYPLAT ?= "0"

# ==================== 平台默认值 ====================
# 对应 Makefile: SMP ?= 4
ARCEOS_SMP ?= "4"

# ==================== QEMU 配置 ====================
# runqemu 标准变量
QB_SYSTEM_NAME = "qemu-system-aarch64"
QB_MACHINE = "-machine virt"
QB_CPU = "-cpu cortex-a72"
QB_MEM = "-m ${ARCEOS_MEM}"
QB_SMP = "-smp ${ARCEOS_SMP}"
QB_DEFAULT_KERNEL = "starry.bin"
# bare-metal 无需 root= 参数，不设置 QB_KERNEL_ROOT
QB_SERIAL_OPT = "-nographic"

# 可选设备（后续扩展）
QB_OPT_APPEND = ""
# 示例：添加网络
# QB_OPT_APPEND += "-device virtio-net-pci,netdev=net0 -netdev user,id=net0"
# 示例：添加块设备
# QB_OPT_APPEND += "-device virtio-blk-pci,drive=disk0 -drive id=disk0,if=none,format=raw,file=disk.img"

SERIAL_CONSOLES = "115200;ttyAMA0"

# 内存大小默认值（与 arceos-defaults.inc 保持一致）
ARCEOS_MEM ?= "1G"
```

## conf/machine/include/arceos-machine-common.inc
```bitbake
# arceos-machine-common.inc
# ArceOS/StarryOS 机器通用配置
#
# 所有 ArceOS 目标机器应该 require 此文件
# 提供裸机内核构建所需的通用配置

# ==================== 内核配置 ====================
# StarryOS 是裸机内核，不使用标准 Linux 内核
PREFERRED_PROVIDER_virtual/kernel = ""

# 内核镜像类型为二进制
KERNEL_IMAGETYPE = "bin"

# ==================== QEMU 通用配置 ====================
# 无图形界面
QB_OPT_APPEND = "-nographic"

# ==================== 必须由具体机器设置的变量 ====================
# 以下变量必须在具体的 machine.conf 中设置:
#
# ARCEOS_ARCH         - 架构 (aarch64/riscv64/loongarch64/x86_64)
# ARCEOS_PLATFORM     - 平台名称 (如 aarch64-qemu-virt)
# ARCEOS_PLAT_PACKAGE - 平台包名 (如 axplat-aarch64-qemu-virt)
# RUST_TARGET         - Rust 目标三元组

# ==================== Rust 目标映射参考 ====================
# ARCEOS_ARCH=aarch64     -> RUST_TARGET=aarch64-unknown-none-softfloat
# ARCEOS_ARCH=riscv64     -> RUST_TARGET=riscv64gc-unknown-none-elf
# ARCEOS_ARCH=loongarch64 -> RUST_TARGET=loongarch64-unknown-none-softfloat
# ARCEOS_ARCH=x86_64      -> RUST_TARGET=x86_64-unknown-none
```

## conf/machine/include/loongarch/tune-loongarch.inc
```bitbake
# LoongArch tuning (minimal)

DEFAULTTUNE ?= "loongarch64"

TUNEVALID[loongarch64] = "Enable 64-bit LoongArch optimizations"

AVAILTUNES += "loongarch64"

TUNE_FEATURES:tune-loongarch64 = "loongarch64"
BASE_LIB:tune-loongarch64 = "lib64"
TUNE_ARCH:tune-loongarch64 = "loongarch64"
TUNE_PKGARCH:tune-loongarch64 = "loongarch64"
PACKAGE_EXTRA_ARCHS:tune-loongarch64 = "loongarch64"

TUNE_ARCH = "${TUNE_ARCH:tune-${DEFAULTTUNE}}"
TUNE_PKGARCH = "${TUNE_PKGARCH:tune-${DEFAULTTUNE}}"
BASE_LIB = "${BASE_LIB:tune-${DEFAULTTUNE}}"

# Match StarryOS build flags for LoongArch soft-float.
TUNE_CCARGS .= " -msoft-float"
```

## conf/machine/loongarch64-qemu-virt.conf
```bitbake
#@TYPE: Machine
#@NAME: loongarch64-qemu-virt
#@DESCRIPTION: LoongArch 64-bit QEMU virt machine for StarryOS/ArceOS

# 基础架构配置
require conf/machine/include/loongarch/tune-loongarch.inc
require conf/machine/include/qemu.inc

# ArceOS 通用配置
require conf/machine/include/arceos-machine-common.inc

# ==================== ArceOS/StarryOS 必须变量 ====================
# 对应 Makefile: ARCH, PLAT_NAME, MYPLAT, TARGET
ARCEOS_ARCH = "loongarch64"
ARCEOS_PLATFORM = "loongarch64-qemu-virt"
ARCEOS_PLAT_PACKAGE = "axplat-loongarch64-qemu-virt"
RUST_TARGET = "loongarch64-unknown-none-softfloat"

# ==================== LoongArch64 架构配置 ====================
TUNE_PKGARCH = "loongarch64"
PACKAGE_EXTRA_ARCHS = "loongarch64"
KERNEL_ARCH = "loongarch"

# ==================== 平台默认值 ====================
ARCEOS_SMP ?= "4"

# ==================== QEMU 配置 ====================
QB_SYSTEM_NAME = "qemu-system-loongarch64"
QB_MACHINE = "-machine virt"
QB_CPU = "-cpu la464"
QB_SMP = "-smp ${ARCEOS_SMP}"
QB_MEM = "-m 2048"
QB_NETWORK_DEVICE = "-device virtio-net-pci,netdev=net0,mac=@MAC@"
QB_KERNEL_CMDLINE_APPEND = "console=ttyS0"

SERIAL_CONSOLES = "115200;ttyS0"
```
